## CMakeLists.txt
```
cmake_minimum_required(VERSION 3.13.1)

# Default config
if(NOT CONF_FILE)
  set(CONF_FILE prj.conf)
endif()

# Allow external config chaining
if(EXTRA_CONF_FILE)
  list(APPEND CONF_FILE ${EXTRA_CONF_FILE})
endif()

set(CONF_FILE "${CONF_FILE}" CACHE STRING "List of configuration files")

find_package(Zephyr REQUIRED HINTS $ENV{ZEPHYR_BASE})

project(bluetooth_rpa)

target_sources(app PRIVATE src/main.c src/aes.c)

add_compile_definitions(MBEDTLS_ENABLE_MASKING=$<BOOL:${CONFIG_MBEDTLS_ENABLE_MASKING}>)
```

## Kconfig
```
config MBEDTLS_ENABLE_MASKING
	bool "Enables masking countermeasure for SCA"
	default n
config INJECT_MASKS
	bool "Enables injecting masks from Unicorn"
	default n

source "Kconfig.zephyr"
```

## prj.conf
```kconfig
CONFIG_MAIN_STACK_SIZE=8192
CONFIG_PRINTK=y
CONFIG_CONSOLE=y

# Bluetooth config
CONFIG_BT=y
# CONFIG_BT_DEVICE_NAME="test_ext_adv"
CONFIG_BT_CENTRAL=y
CONFIG_BT_BROADCASTER=y
CONFIG_BT_SMP=y
CONFIG_BT_HCI=y
CONFIG_BT_ID_MAX=2
CONFIG_BT_PRIVACY=y
CONFIG_BT_RPA_TIMEOUT=10
# CONFIG_BT_RPA_LOG_LEVEL_DBG=y
CONFIG_BT_DEVICE_NAME="Zephyr RPA Attack App"
CONFIG_BT_EXT_ADV=y

# Enable debug logs
CONFIG_LOG=y
# CONFIG_BT_LOG=y
CONFIG_LOG_DEFAULT_LEVEL=4
CONFIG_BT_RPA_LOG_LEVEL_DBG=y

CONFIG_MBEDTLS=y
CONFIG_MBEDTLS_BUILTIN=y
CONFIG_ENTROPY_GENERATOR=y
# Make sure that the AES tables are stored in ROM
# Enables easier emulation since the address of the 
# SBOX tables will be known.
CONFIG_MBEDTLS_AES_ROM_TABLES=y

# Setup for the native_sim
CONFIG_MBEDTLS_ENTROPY_C=y
CONFIG_MBEDTLS_PSA_CRYPTO_C=y
CONFIG_MBEDTLS_PSA_CRYPTO_EXTERNAL_RNG_ALLOW_NON_CSPRNG=y
CONFIG_MBEDTLS_HMAC_DRBG_ENABLED=y

CONFIG_MBEDTLS_ENABLE_MASKING=n
CONFIG_DEBUG_OPTIMIZATIONS=y
```

## inject-masks.conf
```kconfig
# Custom configuration for mbedTLS with masking enabled
CONFIG_MBEDTLS_ENABLE_MASKING=y
# Enable mask injection via Unicorn
CONFIG_INJECT_MASKS=y
```

## masked.conf
```kconfig
# Custom configuration for mbedTLS with masking enabled
CONFIG_MBEDTLS_ENABLE_MASKING=y
```

## src/main.c
```c
#include <zephyr/kernel.h>
#include <zephyr/bluetooth/bluetooth.h>
#include <zephyr/bluetooth/conn.h>
#include <zephyr/bluetooth/addr.h>
#include <zephyr/bluetooth/hci.h>
#include <zephyr/bluetooth/crypto.h>
#include <stdio.h>
#include <zephyr/logging/log.h>

#define MBEDTLS_SELF_TEST
#define MBEDTLS_CIPHER_MODE_ECB
#include "mbedtls/aes.h"

uint8_t irk_key[16] = {0xDE, 0xAD, 0xBE, 0xEF, 0xDE, 0xAD, 0xBE, 0xEF, 0xDE, 0xAD, 0xBE, 0xEF, 0xDE, 0xAD, 0xBE, 0xEF};
uint8_t plaintext[16] __attribute__((section(".uninit")));
uint8_t ciphertext[16];

LOG_MODULE_REGISTER(rpa_attack_app);

int main(void){
	printk("RPA Attack Application\n");

#if defined(SELF_TEST)	
	return mbedtls_aes_self_test(1);
#else
	bt_enable(NULL);
	if(bt_is_ready() != 0){
		LOG_ERR("Bluetooth is not ready!");
		// return -1;
	}
	LOG_INF("Bluetooth is ready!");

	LOG_INF("Creating bluetooth identity...");

	int id = bt_id_create(NULL, irk_key);
	//bt_id_reset(id, NULL, irk_key);

	struct bt_le_ext_adv *adv;
	const struct bt_le_adv_param adv_params = {
		.id = id,
		.options = BT_LE_ADV_OPT_CONN,
		.interval_min = BT_GAP_ADV_FAST_INT_MIN_2,
		.interval_max = BT_GAP_ADV_FAST_INT_MAX_2,
	};

	int err = bt_le_ext_adv_create(&adv_params, NULL, &adv);
	if(err){
		LOG_ERR("Falied to create advertising packet");
		return -1;
	}

	LOG_INF("Starting advertisement...");

	const struct bt_le_ext_adv_start_param ext_adv_params = {
		.timeout = 600,
		.num_events = 255,
	};

	err = bt_le_ext_adv_start(adv, &ext_adv_params);
	if(err){
		LOG_ERR("Failed to start advertising!");
		return -1;
	}

	k_sleep(K_SECONDS(600));

	bt_le_ext_adv_stop(adv);
	bt_le_ext_adv_delete(adv);
#endif /* SELF_TEST */

	return 0;	
}
```
